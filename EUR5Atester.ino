/*
11/18/24
Rewriting NETCOM display tester code as a starting point for creating a tester
for the EUR5A. Will be programming an ATMEGA88P. 
*/

/* 
================|
Configuring I/Os|
================|
Buttons:
PB0 - Start (Input)

===================|
Configuring Display|
===================|


===============|
Configuring SPI|
===============|
Data Lines Cont'd:
PB2 - CS  (Output)
PB3 - MOSI  (Output)
PB4 - MISO  (Input)
PB5 - SCK (Output)
*/

#include <avr/pgmspace.h>
#include "program.h"

#define START_BUTTON    8
#define COMM_RST        A4

#if defined(__AVR_ATmega2560__)
    #define SPI_SCK         52
    #define SPI_MISO        50
    #define SPI_MOSI        51
    #define SPI_CS          53
    // display stuff here
    #define SDIN            46
    #define SCLK            45
    #define CS              48
    #define DC              47
    #define RES             44
    // DUT power
    #define DUT_PWR         31
#else // using UNO 
    #define SPI_SCK         13
    #define SPI_MISO        12
    #define SPI_MOSI        11
    #define SPI_CS          10
    // display stuff here
    #define SDIN            2
    #define SCLK            3
    #define CS              4
    #define DC              5
    #define RES             6
    // DUT power
    #define DUT_PWR         7
#endif


typedef struct {
  char errCode;
  const char *errMsg;
} ErrorInfo;

#define MAJOR_CODE(code) ((code >> 4) & 0x0F)
#define MINOR_CODE(code) (code & 0x0F)

#define EC_DEFAULT_OK     0
#define EC_24V_HIGH       0x10
#define EC_24V_LOW        0x11
#define EC_5V_HIGH        0x12
#define EC_5V_LOW         0x13
#define EC_3_3V_HIGH      0x14
#define EC_3_3V_LOW       0x15
#define EC_FAIL_ENTER     0x20
#define EC_WRONG_CHIP     0x21
#define EC_FAIL_VERIFY    0x22
#define EC_FAIL_FUSE      0x23
#define EC_FAIL_H_FUSE    0x24
#define EC_FAIL_X_FUSE    0x25
#define EC_FAIL_CODE_P    0x26
#define EC_USER_DECLARED  0x60
#define EC_TEST_SET_ERR   0x70
 
const char errmsg10[] = "ERR #1.0: 24V too HIGH";
const char errmsg11[] = "ERR #1.1: 24V too LOW";
const char errmsg12[] = "ERR #1.2: 5V too HIGH";
const char errmsg13[] = "ERR #1.3: 5V too LOW";
const char errmsg14[] = "ERR #1.4: 3.3V too HIGH";
const char errmsg15[] = "ERR #1.5: 3.3V too LOW";
const char errmsg20[] = "ERR #2.0: Chip did not return 0x53; Unable to write to Chip";
const char errmsg21[] = "ERR #2.1: Chip ID is incorrect; Wrong Chip on DUT";
const char errmsg22[] = "ERR #2.2: Failed to verify program";
const char errmsg23[] = "ERR #2.3: Failed to write to FUSE";
const char errmsg24[] = "ERR #2.4: Failed to write to H FUSE";
const char errmsg25[] = "ERR #2.5: Failed to write to X FUSE";
const char errmsg26[] = "ERR #2.6:  Failed to verify code protection";
const char errmsg60[] = "ERR #6.0: User declared error";
const char errmsg70[] = "ERR #7.0: Test Set Error; Relay is ON already before user begins test";

ErrorInfo errorTable[] = {
  {EC_24V_HIGH, errmsg10},
  {EC_24V_LOW, errmsg11},
  {EC_5V_HIGH, errmsg12},
  {EC_5V_LOW, errmsg13},
  {EC_3_3V_HIGH, errmsg14},
  {EC_3_3V_LOW, errmsg15},
  {EC_FAIL_ENTER, errmsg20},
  {EC_WRONG_CHIP, errmsg21},
  {EC_FAIL_VERIFY, errmsg22},
  {EC_FAIL_FUSE, errmsg23},
  {EC_FAIL_H_FUSE, errmsg24},
  {EC_FAIL_X_FUSE, errmsg25},
  {EC_FAIL_CODE_P, errmsg26},
  {EC_USER_DECLARED, errmsg60},
  {EC_TEST_SET_ERR, errmsg70}
};

/****************************************************
*             Hex Table for Example Image           *
*****************************************************/
const unsigned char startScreen[512] PROGMEM = {
0x00, 0x00, 0x00, 0x00, 0x00, 0x00, 0x00, 0x00, 0x00, 0x00, 0x00, 0x00, 0x00, 0x00, 0x00, 0x00,
0x00, 0x00, 0x00, 0x00, 0x00, 0x00, 0x00, 0x00, 0x00, 0x00, 0x00, 0x00, 0x00, 0x00, 0x00, 0x00,
0x00, 0x00, 0x00, 0x00, 0x00, 0x00, 0x00, 0x00, 0x00, 0x00, 0x00, 0x00, 0x00, 0x00, 0x00, 0x00,
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0x00, 0x00, 0x00, 0x00, 0x00, 0x00, 0x00, 0x00, 0x00, 0x00, 0x00, 0x00, 0x00, 0x00, 0x00, 0x00
};


const unsigned char Phase1 [512] PROGMEM = {
0x00, 0x00, 0x00, 0x00, 0x00, 0x00, 0x00, 0x00, 0x00, 0x00, 0x00, 0x00, 0x00, 0x00, 0x00, 0x00,
0x00, 0x00, 0x00, 0x00, 0x00, 0x00, 0x00, 0x00, 0x00, 0x00, 0x00, 0x00, 0x00, 0x00, 0x00, 0x00,
0x00, 0x00, 0x00, 0x00, 0x00, 0x00, 0x00, 0x00, 0x00, 0x00, 0x00, 0x00, 0x00, 0x00, 0x00, 0x00,
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0x00, 0x00, 0x00, 0x00, 0x00, 0x00, 0x00, 0x00, 0x00, 0x00, 0x00, 0x00, 0x00, 0x00, 0x00, 0x00
};

const unsigned char Phase2 [512] PROGMEM = {
0x00, 0x00, 0x00, 0x00, 0xF8, 0xF8, 0x88, 0x88, 0xF8, 0x70, 0x00, 0xE0, 0xE0, 0x80, 0x40, 0x60,
0x60, 0x00, 0xC0, 0xE0, 0x20, 0x20, 0xE0, 0xC0, 0x00, 0xC0, 0xE0, 0x20, 0x20, 0xE0, 0xE0, 0x00,
0x00, 0x00, 0x00, 0x00, 0x00, 0x00, 0x00, 0x00, 0x00, 0x00, 0xF8, 0xF8, 0x88, 0x88, 0x88, 0x08,
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0x08, 0x08, 0x08, 0x08, 0x08, 0x08, 0x08, 0x0F, 0x00, 0x00, 0x00, 0x00, 0x00, 0x00, 0x00, 0x00
};


const unsigned char Phase3 [512] PROGMEM = {
0x00, 0x00, 0x00, 0x00, 0xF8, 0xF8, 0x88, 0x88, 0xF8, 0x70, 0x00, 0xE0, 0xE0, 0x80, 0x40, 0x60,
0x60, 0x00, 0xC0, 0xE0, 0x20, 0x20, 0xE0, 0xC0, 0x00, 0xC0, 0xE0, 0x20, 0x20, 0xE0, 0xE0, 0x00,
0xE0, 0xE0, 0x80, 0x80, 0x40, 0x60, 0x60, 0x00, 0x40, 0x60, 0x20, 0x20, 0xE0, 0xC0, 0x00, 0xE0,
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0x08, 0x08, 0x08, 0x08, 0x08, 0x08, 0x08, 0x0F, 0x00, 0x00, 0x00, 0x00, 0x00, 0x00, 0x00, 0x00
};


const unsigned char Phase4 [512] PROGMEM = {
0x00, 0x00, 0x00, 0x00, 0x70, 0xF8, 0x88, 0x88, 0x98, 0x10, 0x00, 0xC0, 0xE0, 0x20, 0x20, 0xE0,
0xC0, 0x00, 0x20, 0xF0, 0xF0, 0x20, 0x20, 0x00, 0x00, 0x00, 0x00, 0x00, 0x00, 0x00, 0x00, 0xF8,
0xF8, 0x88, 0x88, 0x08, 0x08, 0x00, 0xE0, 0xE0, 0x00, 0x00, 0xE0, 0xE0, 0x00, 0xC0, 0xE0, 0x20,
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0x08, 0x08, 0x08, 0x08, 0x08, 0x08, 0x08, 0x0F, 0x00, 0x00, 0x00, 0x00, 0x00, 0x00, 0x00, 0x00
};


const unsigned char completeScreen [512] PROGMEM = {
0x00, 0x00, 0x00, 0x00, 0x00, 0x00, 0x00, 0x00, 0x00, 0x00, 0x00, 0x00, 0x00, 0x00, 0x00, 0x00,
0x00, 0x00, 0x00, 0x00, 0x00, 0x00, 0x00, 0x00, 0x00, 0x00, 0x00, 0x00, 0x00, 0x00, 0x00, 0x00,
0x00, 0x00, 0x00, 0x00, 0x00, 0x00, 0x00, 0x00, 0x00, 0x00, 0x00, 0x00, 0x00, 0x00, 0x00, 0x00,
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0x00, 0x00, 0x00, 0x00, 0x00, 0x00, 0x00, 0x00, 0x00, 0x00, 0x00, 0x00, 0x00, 0x00, 0x00, 0x00
};


const unsigned char restartingScreen [512] PROGMEM = {
0x00, 0x00, 0x00, 0x00, 0x00, 0x00, 0x00, 0x00, 0x00, 0x00, 0x00, 0x00, 0x00, 0x00, 0x00, 0x00,
0x00, 0x00, 0x00, 0x00, 0x00, 0x00, 0x00, 0x00, 0x00, 0x00, 0x00, 0x00, 0x00, 0x00, 0x00, 0x00,
0x00, 0x00, 0x00, 0x00, 0x00, 0x00, 0x00, 0x00, 0x00, 0x00, 0x00, 0x00, 0x00, 0x00, 0x00, 0x00,
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0x00, 0x00, 0x00, 0x00, 0x00, 0x00, 0x00, 0x00, 0x00, 0x00, 0x00, 0x00, 0x00, 0x00, 0x00, 0x00
};

const unsigned char ErrorCode [512] PROGMEM = {
0x00, 0x00, 0x00, 0x00, 0x00, 0x00, 0x00, 0x00, 0x00, 0x00, 0x00, 0x00, 0x00, 0x00, 0x00, 0x00,
0x00, 0x00, 0x00, 0x00, 0x00, 0x00, 0x00, 0x00, 0x00, 0x00, 0x00, 0x00, 0x00, 0x00, 0x00, 0x00,
0x00, 0x00, 0x00, 0x00, 0x00, 0x00, 0x00, 0x00, 0x00, 0x00, 0x00, 0x00, 0x00, 0x00, 0x00, 0x00,
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0x00, 0x00, 0x00, 0x00, 0x00, 0x00, 0x00, 0x00, 0x00, 0x00, 0x00, 0x00, 0x00, 0x00, 0x00, 0x00
};


const unsigned char xDrawing [28] PROGMEM = {
0xF8, 0x08, 0x28, 0x48, 0x88, 0x48, 0x28, 0x08, 0xF8, 0x00, 0x00, 0x00, 0x00, 0x00,
0x0F, 0x08, 0x0A, 0x09, 0x08, 0x09, 0x0A, 0x08, 0x0F, 0x00, 0x00, 0x00, 0x00, 0x00
};

const unsigned char checkDrawing [28] PROGMEM = {
0xF8, 0x28, 0x68, 0xC8, 0x88, 0x08, 0xC8, 0xE8, 0xF8, 0x18, 0x0C, 0x04, 0x06, 0x02,
0x0F, 0x08, 0x08, 0x09, 0x0F, 0x0F, 0x0B, 0x08, 0x0F, 0x00, 0x00, 0x00, 0x00, 0x00
};

const unsigned char numberZero [12] PROGMEM = {
0xE0, 0xF0, 0x10, 0x90, 0xF0, 0xE0,
0x0F, 0x1F, 0x13, 0x11, 0x1F, 0x0F
};

const unsigned char numberOne [12] PROGMEM = {
0xC0, 0x60, 0xF0, 0xF0, 0x00, 0x00,
0x00, 0x00, 0x1F, 0x1F, 0x00, 0x00
};

const unsigned char numberTwo [12] PROGMEM = {
0x20, 0x30, 0x10, 0x90, 0xF0, 0x60,
0x1C, 0x1E, 0x13, 0x11, 0x10, 0x10,
};

const unsigned char numberThree [12] PROGMEM = {
0x20, 0x30, 0x10, 0x10, 0xF0, 0xE0,
0x08, 0x18, 0x11, 0x11, 0x1F, 0x0E
};

const unsigned char numberFour [12] PROGMEM = {
0x00, 0x80, 0xC0, 0x60, 0xF0, 0xF0,
0x03, 0x03, 0x02, 0x02, 0x1F, 0x1F
};

const unsigned char numberFive [12] PROGMEM = {
0xF0, 0xF0, 0x90, 0x90, 0x90, 0x10,
0x08, 0x18, 0x10, 0x10, 0x1F, 0x0F
};

const unsigned char numberSix [12] PROGMEM = {
0xE0, 0xF0, 0x10, 0x10, 0x30, 0x20,
0x0F, 0x1F, 0x11, 0x11, 0x1F, 0x0F
};

const unsigned char numberSeven [12] PROGMEM = {
0x10, 0x10, 0x10, 0x90, 0xF0, 0x70,
0x1C, 0x1E, 0x03, 0x01, 0x00, 0x00
};

// Volatile variable for 'counter' used to blink Testing LED (Yellow)
static volatile char testingMode;

volatile uint8_t optjunk;

// Error Code 
char errCode;   // errCode = doTest
char errSubCode; // errSubCode = Passed from functions inside doTest
char verifyComm;
char verifyButton;
char initCheck;

// For programming
char pagebuf[64];

// Test Pass
uint8_t passTest = 0;
uint8_t failTest = 0;

// Function Prototypes
void setup(void);
void loop(void);
void initADC(void);
void initSPImaster(void);
void SPI_write(char cData);
char SPI_read(void);
char SPI_read_noprint(void);
void handleError(char errCode);
char checkUserFail(void);
char checkUserPassOrFail(void);
char printADCValue(uint8_t channel);
char checkComm(void);
char checkButtonShort(void);
char blinkERRCode(uint8_t major, uint8_t minor);
char blinkDelay(void);
char enableProgram(void);
char getChipID(void);
char getFuses(void);
char getLockBits(void);

void eraseChip(void);
void programChip(const uint8_t* data, unsigned int length);
unsigned int verifyProgram(const uint8_t* data, unsigned int length);
unsigned int codeget(unsigned int addr);
void enableSerialProgram(void);
void disableSerialProgram(void);
char doTest(void);

void initIOs() {
  pinMode(DUT_PWR, OUTPUT);
  digitalWrite(DUT_PWR, LOW);

  pinMode(CS, OUTPUT);
  pinMode(DC, OUTPUT);
  pinMode(SCLK, OUTPUT);
  pinMode(SDIN, OUTPUT);
  pinMode(RES, OUTPUT);

  pinMode(COMM_RST, OUTPUT);

  // Set bits 0 1 of PORTB, bit 5 of PORTC, bit 2 of PORTD, as inputs
  pinMode(START_BUTTON, INPUT);

  // Set falling edge trigger for INT0
  EICRA |= (1 << ISC01);
  EICRA &= ~(1 << ISC00);

  // Set rising edge trigger for INT1; Button is active high
  EICRA |= (1 << ISC11) | (1 << ISC10);

  // Clear the interrupt flag for INT0
  EIFR |= (1 << INTF0);
  EIFR |= (1 << INTF1);
}

void initADC() {
  // Set the reference voltage to AVCC and left-adjust the result
  ADMUX = (1 << REFS0);
  // Enable the ADC and set the prescaler to 64 (125 kHz)
  ADCSRA = (1 << ADEN) | (1 << ADPS2) | (1 << ADPS1);
  // Disable unused digital input buffers
  DIDR0 = (1 << ADC0D) | (1 << ADC1D) | (1 << ADC2D);
}

uint16_t readADC(uint8_t channel) {
  // ADC section here
  ADMUX = (ADMUX & 0xF0) | (channel & 0x0F);
  // Start the conversion
  ADCSRA |= (1 << ADSC);
  // Wait for the conversion to complete
  while (ADCSRA & (1 << ADSC));
  // Clear the ADIF flag by writing a logic 1 to it
  ADCSRA |= (1 << ADIF);
  // Return the full 10-bit ADC result
  return ADC;
}

void initSPImaster(void) {
  // Set CS, MOSI, and SCK output, all others input */
  pinMode(SPI_CS, OUTPUT);
  pinMode(SPI_MOSI, OUTPUT);
  pinMode(SPI_SCK, OUTPUT);
  pinMode(SPI_MISO, INPUT);
  // Enable SPI, Master, set clock rate fck/16 */
  SPCR = (1<<SPE)|(1<<MSTR)| (1<<SPR1)|(1<<SPR0);
}

void SPI_write(char cData) {
    // Start transmission
    SPDR = cData;
    // Wait for transmission complete
    while(!(SPSR & (1<<SPIF)));
    // Read and throw away resposne
    optjunk = SPDR;
}

char SPI_read() {
  char buffer[3]; 
  char data = 0x00;
  SPDR = data;
  while(!(SPSR & (1<<SPIF)));
  optjunk = SPDR;
  Serial.print(F("Response:"));
  sprintf(buffer, "0x%02X", optjunk); 
  Serial.println(buffer);
  return optjunk;
}

char SPI_read_noprint() {
  char data = 0x00;
  SPDR = data;
  while(!(SPSR & (1<<SPIF)));
  optjunk = SPDR;
  return optjunk;
}

// Function to handle errors
void handleError(char errCode) {
  for (uint8_t i = 0; i < sizeof(errorTable) / sizeof(errorTable[0]); i++) {
    if (errorTable[i].errCode == errCode) {
      Serial.println(F("\n====="));
      Serial.print(F("ERROR: "));
      Serial.println(errorTable[i].errMsg); 
      Serial.println(F("=====\n"));
      int major = MAJOR_CODE(errCode);
      int minor = MINOR_CODE(errCode);
      blinkERRCode(major, minor); // If user presses start while in this function, it will break out of the handleError section and run goto restartLoop
      break;
    }
  }
}

char checkUserFail() {
  if (EIFR & (1<<INTF1)) {
    EIFR |= (1 << INTF1);
    return EC_USER_DECLARED;
  } else {
    return 0;//
  }
}

char checkUserPassOrFail() {
  uint8_t i;
  for (i = 0; i < 65; i++) {
    delay(10);
    if (digitalRead(START_BUTTON) == HIGH)
    {
      Serial.println(F("User declares PASS"));
      EIFR |= (1 << INTF1);
      return 1;
    }
    if (EIFR & (1<<INTF1)) {
      // Clear the PCIE1 flag by writing a logic 1 to it
      EIFR |= (1 << INTF1);
      failTest = EC_USER_DECLARED;
      return 1;
    }
  }
  return 0;
}

char printADCValue(uint8_t channel) {
  uint16_t math = (channel == 3) ? readADC(2) : readADC(channel);
  if (channel == 0) {
   Serial.print(F("ADC #3"));
    Serial.print(F(" (5V/2 = 2.5V)"));
  } else if (channel == 1) {
    Serial.print(F("ADC #2"));
    Serial.print(F(" (3.3V = 3.3V)"));
  } else if (channel == 2) {
    Serial.print(F("ADC #1"));  
    Serial.print(F(" (24V -> = 3.3V)"));
  }
  Serial.print(F(" is: "));
  float analog = (math * 5.0) / 1024.0;
  Serial.print(analog, 2);
  Serial.println(F("V"));
  if (channel == 0) {
    if (analog > 2.7) {
      Serial.print("EC 5V HIGH");
      return EC_5V_HIGH;
    } else if (analog < 2.3) {
       Serial.print("EC 5V LOW");
      return EC_5V_LOW;
    }
  } else if (channel == 1) {
    if (analog > 3.7) {
      return EC_3_3V_HIGH;
    } else if (analog < 3.1) {
      return EC_3_3V_LOW;
    }
  } else if (channel == 2) {
    if (analog > 3.465) {
      return EC_24V_HIGH;
    } else if (analog < 3.135) {
      return EC_24V_LOW;
    }
  } else if (channel == 3) { // Really is channel 2, but for low V detection
    if (analog > 0.2) {
      return EC_TEST_SET_ERR;
    }
  }
  return 0;
}

char blinkDelay() {
  uint8_t i;
  for (i = 0; i < 50; i++) {
    delay(10);
    if (digitalRead(START_BUTTON) == LOW) {
      return 1;
    }
  }
  return 0;
}

char blinkERRCode(uint8_t major, uint8_t minor) {
  testingMode = 2; 
  Fill_RAM_12832(0x00);
  ImageDisplay(ErrorCode);
  paintNumber(0, major);
  paintNumber(1, minor);
  while(1) {
    if (blinkDelay()) return 0;
  }
}

char enableProgram() {
  uint8_t verifyEnable;
  Serial.print(F("Programming Enable (Expecting 0x53) - "));
  SPI_write(0xAC);
  SPI_write(0x53);
  verifyEnable = SPI_read();
  SPI_write(0x00);
  // Just check it's decimal value (0x53 = 83 decimal)
  if (verifyEnable != 83) { // If didn't get 83 as a response, then didn't enter programming mode
    return EC_FAIL_ENTER;
  }
  return 0;
}

char getChipID() {
  uint8_t verifyID;
  // Read CHIP ID
  Serial.print(F("Chip ID addr #0 (Expecting 1E) - "));
  SPI_write(0x30);
  SPI_write(0x00);
  SPI_write(0x00);
  verifyID = SPI_read();
  if (verifyID != 0x1E) {
    return EC_WRONG_CHIP;
  }
  //
  Serial.print(F("Chip ID addr #1 (Expecting 93) - "));
  SPI_write(0x30);
  SPI_write(0x00);
  SPI_write(0x01);
  verifyID = SPI_read();
  if (verifyID != 0x93) {
    return EC_WRONG_CHIP;
  }
  //
  Serial.print(F("Chip ID addr #2 (Expecting 0F) - "));
  SPI_write(0x30);
  SPI_write(0x00);
  SPI_write(0x02);
  verifyID = SPI_read();
  if (verifyID != 0x0F) {
    return EC_WRONG_CHIP;
  }
  return 0;
}

char getFuses() {
  uint8_t verifyFuses;
  Serial.print(F("Fuse write & read (0x62) - "));
  SPI_write(0xAC);
  SPI_write(0xA0);
  SPI_write(0x00);
  SPI_write(0x62);
  delay(10);
  //
  SPI_write(0x50);
  SPI_write(0x00);
  SPI_write(0x00);
  verifyFuses = SPI_read();
  if (verifyFuses != 0x62) {
    return EC_FAIL_FUSE;
  }
  //
  Serial.print(F("H Fuse write & read (0xDF) - "));
  SPI_write(0xAC);
  SPI_write(0xA8);
  SPI_write(0x00);
  SPI_write(0xDF);
  delay(10);
  //
  SPI_write(0x58);
  SPI_write(0x08);
  SPI_write(0x00);
  verifyFuses = SPI_read();
  if (verifyFuses != 0xDF) {
    return EC_FAIL_H_FUSE;
  }
  Serial.print(F("X Fuse write & read (0xF9) - "));
  //
  SPI_write(0xAC);
  SPI_write(0xA4);
  SPI_write(0x00);
  SPI_write(0xF9);
  delay(10);
  //
  SPI_write(0x50);
  SPI_write(0x08);
  SPI_write(0x00);
  verifyFuses = SPI_read(); 
  if (verifyFuses != 0xF9) {
    return EC_FAIL_X_FUSE;
  }
  return 0; 
}

char getLockBits() {
  uint8_t verifyLockbits;
  Serial.print(F("LockBits write & read (0xFE) - "));
  SPI_write(0xAC);
  SPI_write(0xE0);
  SPI_write(0x00);
  SPI_write(0xFE);
  delay(10);
  // reading
  SPI_write(0x58);
  SPI_write(0x00);
  SPI_write(0x00);
  verifyLockbits = SPI_read();
  if (verifyLockbits != 0xFE) {
    return EC_FAIL_CODE_P;
  }
  return 0;
}

void eraseChip() {
  Serial.println(F("Erasing chip..."));
  SPI_write(0xAC);
  SPI_write(0x80);
  SPI_write(0x00);
  SPI_write(0x00);
}

void programChip(const uint8_t* data, unsigned int length) {
  Serial.println(F("Programing chip..."));
  unsigned int bytesleft;
  unsigned int bytesinpage;
  int i;  // addr LSB
  char *p;
  char x; // High/Low data byte in
  unsigned int pageaddr;
  bytesleft = length;
  pageaddr = 0;
  //Serial.println("Before if");
  int numpage = 0;
  while(bytesleft != 0)
  {
    if(bytesleft < 64)
    {
      //fill partial page
      memset(pagebuf,0xff,64);  
      bytesinpage=bytesleft;
    }
    else bytesinpage = 64;
    memcpy_P(pagebuf, data, bytesinpage);
    data += bytesinpage;
    bytesleft -= bytesinpage;
    //Serial.print("bytesleft: ");
    //Serial.println(bytesleft);
    p = pagebuf;
    // For 1 page; 32 words; 64 bytes per page; 128 pages total
    numpage++;
    for (i=0; i<32; i++) 
    {
      //Serial.print(".");
      x=*(p++);
      // Load Program Memory Page, Low byte
      SPI_write(0x40);
      SPI_write(0x00);
      SPI_write(i);
      SPI_write(x);
      x=*(p++);
      // Load Program Memory Page, High byte
      SPI_write(0x48);
      SPI_write(0x00);
      SPI_write(i);
      SPI_write(x);
    }
    //Serial.print("\n");
    // Write Program Memory Page
    SPI_write(0x4C);
    SPI_write(pageaddr>>8);
    SPI_write(pageaddr&0xff);
    SPI_write(0x00);
    pageaddr+=32;
    delay(10);
  }
}

unsigned int verifyProgram(const uint8_t* data, unsigned int length) {
  Serial.println(F("Verifying program..."));
  unsigned int wordsinpage;
  unsigned int i;
  unsigned int *p;
  unsigned int x;
  unsigned int codeaddr;
  codeaddr = 0;
  wordsinpage = 0;
  for (i=0; i<length; i+=2)
  {
    if (wordsinpage == 0)
    {
      memcpy_P(pagebuf, data, 64);
      p = (unsigned int *)(pagebuf);
      data += 64;
      wordsinpage = 32;
    }
    x = codeget(codeaddr);
    //Serial.println(x, HEX);
    //Serial.println(*p, HEX);
    if (x!=*p) return EC_FAIL_VERIFY;
    p++;
    codeaddr++;
    wordsinpage--;
  }
  return 0;
}

unsigned int codeget(unsigned int addr) {
  unsigned char xl, xh;
  unsigned char al, ah;
  ah = addr>>8;
  al = addr&0xff;
  // Read Program Memory, Low Byte
  SPI_write(0x20);
  SPI_write(ah);
  SPI_write(al);
  xl = SPI_read_noprint();
  // Read Program Memory, High Byte
  SPI_write(0x28);
  SPI_write(ah);
  SPI_write(al);
  xh = SPI_read_noprint();
  // Combine into 16-bit value
  return ((xh<<8) | xl);
}

void enableSerialProgram() {
  // Bring RST LOW; Serial Program enabled
  digitalWrite(COMM_RST, LOW);
}

void disableSerialProgram() {
  // Bring RST HIGH; Normal operation; Don't need to Serial Program
  digitalWrite(COMM_RST, HIGH);
}




/* doTest's program flow
- Check voltages for 24V and 5V
- Turn on Power using Relay
- Check voltages again
- Program and Verify of display board
- Release chip
*/

char doTest() {
  disableSerialProgram();
  delay(250);
  enableSerialProgram();
  delay(250);
  #if(1)
  // Programming Mode...
  Serial.println(F("\n============================================="));
  Serial.println(F("Programming Mode: Enable programming/Read "));
  Serial.println(F("Chip ID/Erase/Program/Verify/Set Fuses"));
  Serial.println(F("=============================================\n"));
  Fill_RAM_12832(0x00);
  delay(250);

  ImageDisplay(Phase2); // prog enable & verify chip id w/ check boxes
  delay(500);
  errSubCode = enableProgram();
  if (errSubCode) {
    paintX(0, xDrawing);
    delay(500);
    return errSubCode;
  }
  paintCheck(0, checkDrawing);
  delay(500);
  errSubCode = getChipID(); // Need to find ChipID
  if (errSubCode) {
    paintX(1, xDrawing);
    delay(500);
    return errSubCode;
  }
  paintCheck(1, checkDrawing);
  delay(500);
  eraseChip();
  Fill_RAM_12832(0x00);

  ImageDisplay(Phase3); // program chip & verify program w/ check boxes
  delay(500);
  programChip(prog, sizeof(prog));
  Serial.println("---");
  delay(100);
  paintCheck(0, checkDrawing);
  delay(500);
  errSubCode = verifyProgram(prog, sizeof(prog));
  if (errSubCode) {
    paintX(1, xDrawing);delay(500);
    return errSubCode; 
  }
  paintCheck(1, checkDrawing);
  delay(500);
  Fill_RAM_12832(0x00);

  ImageDisplay(Phase4); // fuses and lockbits w/ check boxes
  delay(500);
  errSubCode = getFuses();
  if (errSubCode) {
    paintX(0, xDrawing);
    delay(500);
    return errSubCode;
  }
  paintCheck(0, checkDrawing);
  delay(500);
  errSubCode = getLockBits();
  if (errSubCode) {
    paintX(1, xDrawing);
    delay(500);
    return errSubCode;
  }
  paintCheck(1, checkDrawing);
  delay(500);
  // Done programming...
  #endif
  disableSerialProgram(); // RST HIGH
  delay(50);
  enableSerialProgram();  // RST LOW
  delay(50);
  disableSerialProgram(); // RST HIGH
  return 0;
}

// display code
/****************************************************
*                 Function Commands                  *
*****************************************************/

void data_out(unsigned char d) //Data Output Serial Interface
{
  unsigned int n;
    digitalWrite(CS, LOW); 
    digitalWrite(DC, HIGH); 
    for(n=0;n<8;n++){
      if((d&0x80)==0x80)
      digitalWrite(SDIN, HIGH);
      else
      digitalWrite(SDIN, LOW);
      while(0);
      d=(d<<1);
      digitalWrite(SCLK, LOW);
      while(0);
      digitalWrite(SCLK, HIGH);
      while(0); 
      digitalWrite(SCLK, LOW);
      }
    digitalWrite(CS, HIGH); 
}

void comm_out(unsigned char d) //Command Output Serial Interface
{
  unsigned int n;
  digitalWrite(CS, LOW); 
  digitalWrite(DC, LOW); 
  for(n=0;n<8;n++){
    if((d&0x80)==0x80)
    digitalWrite(SDIN, HIGH);
    else
    digitalWrite(SDIN, LOW);
    while(0);
    d=(d<<1);
    digitalWrite(SCLK, LOW);
    while(0);
    digitalWrite(SCLK, HIGH);
    while(0);
    digitalWrite(SCLK, LOW); 
    }
  digitalWrite(CS, HIGH);
}

/****************************************************
*                 Display Commands                   *
*****************************************************/

//--------------------------------------------------------------------------
//--------------------------------------------------------------------------

void Set_Start_Column_12832(unsigned char d)
{
	comm_out(0x00+d%16);		// Set Lower Column Start Address for Page Addressing Mode
						//   Default => 0x00
	comm_out(0x10+d/16);		// Set Higher Column Start Address for Page Addressing Mode
						//   Default => 0x10
}
//--------------------------------------------------------------------------

void Set_Addressing_Mode_12832(unsigned char d)
{
	comm_out(0x20);			// Set Memory Addressing Mode
	comm_out(d);			//   Default => 0x02
						//     0x00 => Horizontal Addressing Mode
						//     0x01 => Vertical Addressing Mode
						//     0x02 => Page Addressing Mode
}
//--------------------------------------------------------------------------

void Set_Column_Address_12832(unsigned char a, unsigned char b)
{
	comm_out(0x21);			// Set Column Address
	comm_out(a);			//   Default => 0x00 (Column Start Address)
	comm_out(b);			//   Default => 0x83 (Column End Address)
}
//--------------------------------------------------------------------------

void Set_Page_Address_12832(unsigned char a, unsigned char b)
{
	comm_out(0x22);			// Set Page Address
	comm_out(a);			//   Default => 0x00 (Page Start Address)
	comm_out(b);			//   Default => 0x07 (Page End Address)
}
//--------------------------------------------------------------------------

void Set_Start_Line_12832(unsigned char d)
{
	comm_out(0x40|d);			// Set Display Start Line
						          //   Default => 0x40 (0x00)
}
//--------------------------------------------------------------------------

void Set_Contrast_Control_12832(unsigned char d)
{
	comm_out(0x81);			// Set Contrast Control for Bank 0
	comm_out(d);			//   Default => 0x80
}
//--------------------------------------------------------------------------

void Set_Area_Brightness_12832(unsigned char d)
{
	comm_out(0x82);			// Set Brightness for Area Color Banks
	comm_out(d);			//   Default => 0x80
}
//--------------------------------------------------------------------------

void Set_Segment_Remap_12832(unsigned char d)
{
	comm_out(0xA0|d);			// Set Segment Re-Map
						//     Default => 0xA0
						//     0xA0 (0x00) => Column Address 0 Mapped to SEG0
						//     0xA1 (0x01) => Column Address 0 Mapped to SEG131
}
//--------------------------------------------------------------------------

void Set_Entire_Display_12832(unsigned char d)
{
	comm_out(0xA4|d);			// Set Entire Display On / Off
						//     Default => 0xA4
						//     0xA4 (0x00) => Normal Display
						//     0xA5 (0x01) => Entire Display On
}
//--------------------------------------------------------------------------

void Set_Inverse_Display_12832(unsigned char d)
{
	comm_out(0xA6|d);			// Set Inverse Display On/Off
						//     Default => 0xA6
						//     0xA6 (0x00) => Normal Display
						//     0xA7 (0x01) => Inverse Display On
}
//--------------------------------------------------------------------------

void Set_Multiplex_Ratio_12832(unsigned char d)
{
	comm_out(0xA8);			// Set Multiplex Ratio
	comm_out(d);			//   Default => 0x3F (1/64 Duty)
}
//--------------------------------------------------------------------------

void Set_Dim_Mode_12832(unsigned char a, unsigned char b)
{
	comm_out(0xAB);			// Set Dim Mode Configuration
	comm_out(0X00);			//           => (Dummy Write for First Parameter)
	comm_out(a);			//   Default => 0x80 (Contrast Control for Bank 0)
	comm_out(b);			//   Default => 0x80 (Brightness for Area Color Banks)
	comm_out(0xAC);			// Set Display On in Dim Mode
}
//--------------------------------------------------------------------------

void Set_Master_Config_12832(unsigned char d)
{
	comm_out(0xAD);			// Set Master Configuration
	comm_out(0x8E|d);			//   Default => 0x8E
						//     0x8E (0x00) => Select External VCC Supply
						//     0x8F (0x01) => Select Internal DC/DC Voltage Converter
}
//--------------------------------------------------------------------------

void Set_Display_On_Off_12832(unsigned char d)	
{
	comm_out(0xAE|d);			// Set Display On/Off
						//     Default => 0xAE
						//     0xAE (0x00) => Display Off
						//     0xAF (0x01) => Display On
}
//--------------------------------------------------------------------------

void Set_Start_Page_12832(unsigned char d)
{
	comm_out(0xB0|d);			// Set Page Start Address for Page Addressing Mode
						//   Default => 0xB0 (0x00)
}
//--------------------------------------------------------------------------

void Set_Common_Remap_12832(unsigned char d)
{
	comm_out(0xC0|d);			// Set COM Output Scan Direction
						//     Default => 0xC0
						//     0xC0 (0x00) => Scan from COM0 to 63
						//     0xC8 (0x08) => Scan from COM63 to 0
}
//--------------------------------------------------------------------------

void Set_Display_Offset_12832(unsigned char d)
{
	comm_out(0xD3);			// Set Display Offset
	comm_out(d);			//   Default => 0x00
}
//--------------------------------------------------------------------------

void Set_Display_Clock_12832(unsigned char d)
{
	comm_out(0xD5);			// Set Display Clock Divide Ratio / Oscillator Frequency
	comm_out(d);			//   Default => 0x70
						//     D[3:0] => Display Clock Divider
						//     D[7:4] => Oscillator Frequency
}
//--------------------------------------------------------------------------

void Set_Area_Color_12832(unsigned char d)
{
	comm_out(0xD8);			// Set Area Color Mode On/Off & Low Power Display Mode
	comm_out(d);			//   Default => 0x00 (Monochrome Mode & Normal Power Display Mode)
}
//--------------------------------------------------------------------------

void Set_Precharge_Period_12832(unsigned char d)
{
	comm_out(0xD9);			// Set Pre-Charge Period
	comm_out(d);			//   Default => 0x22 (2 Display Clocks [Phase 2] / 2 Display Clocks [Phase 1])
						//     D[3:0] => Phase 1 Period in 1~15 Display Clocks
						//     D[7:4] => Phase 2 Period in 1~15 Display Clocks
}
//--------------------------------------------------------------------------

void Set_Common_Config_12832(unsigned char d)
{
	comm_out(0xDA);			// Set COM Pins Hardware Configuration
	comm_out(0x02|d);	//   Default => 0x12 (0x10)
						//     Alternative COM Pin Configuration
						//     Disable COM Left/Right Re-Map
}
//--------------------------------------------------------------------------

void Set_VCOMH_12832(unsigned char d)
{
	comm_out(0xDB);			// Set VCOMH Deselect Level
	comm_out(d);			//   Default => 0x34 (0.77*VCC)
}
//--------------------------------------------------------------------------

void Set_Read_Modify_Write_12832(unsigned char d)
{
	comm_out(0xE0|d);			// Set Read Modify Write Mode
						//     Default => 0xE0
						//     0xE0 (0x00) => Enter Read Modify Write
						//     0xEE (0x0E) => Exit Read Modify Write
}
//--------------------------------------------------------------------------

void Set_NOP_12832()
{
	comm_out(0xE3);			// Command for No Operation
}
//--------------------------------------------------------------------------


//-=-=-=-=-=-=-=-=-=-=-=-=-=-=-=-=-=-=-=-=-=-=-=-=-=-=-=-=-=-=-=-=-=-=-=
//  Show Checkboard (Full Screen)
//-=-=-=-=-=-=-=-=-=-=-=-=-=-=-=-=-=-=-=-=-=-=-=-=-=-=-=-=-=-=-=-=-=-=-=
void Checkerboard_12832()
{
unsigned char i,j;
  
  for(i=0;i<4;i++)
  {
    Set_Start_Page_12832(i);
    Set_Start_Column_12832(0x00);

    for(j=0;j<66;j++)
    {
      data_out(0x55);
      data_out(0xaa);
    }
  }
}

//-=-=-=-=-=-=-=-=-=-=-=-=-=-=-=-=-=-=-=-=-=-=-=-=-=-=-=-=-=-=-=-=-=-=-=
//  Show Regular Pattern (Full Screen)
//-=-=-=-=-=-=-=-=-=-=-=-=-=-=-=-=-=-=-=-=-=-=-=-=-=-=-=-=-=-=-=-=-=-=-=
void Fill_RAM_12832(unsigned char Data)
{
unsigned char i,j;

  for(i=0;i<4;i++)
  {
    Set_Start_Page_12832(i);
    Set_Start_Column_12832(0x00);

    for(j=0;j<132;j++)
    {
      data_out(Data);
    }
  }
}

//-=-=-=-=-=-=-=-=-=-=-=-=-=-=-=-=-=-=-=-=-=-=-=-=-=-=-=-=-=-=-=-=-=-=-=
//  Show Image (Full Screen)
//-=-=-=-=-=-=-=-=-=-=-=-=-=-=-=-=-=-=-=-=-=-=-=-=-=-=-=-=-=-=-=-=-=-=-=

void ImageDisplay(const unsigned char *image)
{
  unsigned int i,j,a;
  a = 0;
  for(i=0;i<4;i++){        
    Set_Start_Page_12832(i);
    Set_Start_Column_12832(0x00);
    for(j=0;j<128;j++){     //128 columns wide
      unsigned char byte = pgm_read_byte(&image[a]);
      data_out(byte);    //send picture data
      a++; 
    }
  }
}

void paintCheck(int n, const unsigned char *image)
{
   // do top
  if (n == 0) {
    unsigned int i,j,a;
    a = 0;
    for(i=0;i<2;i++){        
      Set_Start_Page_12832(i);
      Set_Start_Column_12832(0x6f);
      for(j=0;j<14;j++) {     //128 columns wide
        unsigned char byte = pgm_read_byte(&image[a]);
      data_out(byte);    //send picture data
      a++; 
      }
    } 
  } else if (n == 1) { // do bottom
    unsigned int i,j,a;
    a = 0;
    for(i=2;i<4;i++){        
      Set_Start_Page_12832(i);
      Set_Start_Column_12832(0x6f);
      for(j=0;j<14;j++){     //128 columns wide
        unsigned char byte = pgm_read_byte(&image[a]);
        data_out(byte);    //send picture data
        a++; 
      }
    }
  }
}

void paintNumber(int column, int num) {
  const unsigned char *number = NULL;
  if (num == 0) {
    number = numberZero;
  } else if (num == 1) {
    number = numberOne;
  } else if (num == 2) {
    number = numberTwo;
  } else if (num == 3) {
    number = numberThree;
  } else if (num == 4) {
    number = numberFour;
  } else if (num == 5) {
    number = numberFive;
  } else if (num == 6) {
    number = numberSix;
  } else if (num == 7) {
    number = numberSeven;
  }
  if (column == 0) {
    unsigned int i,j,a;
    a = 0;
    for(i=1;i<3;i++){        
      Set_Start_Page_12832(i);
      Set_Start_Column_12832(0x5f);
      for(j=0;j<6;j++){     //128 columns wide
        unsigned char byte = pgm_read_byte(&number[a]);
        data_out(byte);    //send picture data
        a++; 
      }
    } 
  } else if (column == 1) {
    unsigned int i,j,a;
    a = 0;
    for(i=1;i<3;i++){        
      Set_Start_Page_12832(i);
      Set_Start_Column_12832(0x67);
      for(j=0;j<6;j++){     //128 columns wide
        unsigned char byte = pgm_read_byte(&number[a]);
        data_out(byte);    //send picture data
        a++;  
      }
    } 
  }
}

void paintX(int n, const unsigned char *image)
{
  // do top
  if (n == 0) {
    unsigned int i,j,a;
    a = 0;
    for(i=0;i<2;i++){        
      Set_Start_Page_12832(i);
      Set_Start_Column_12832(0x6f);
      for(j=0;j<14;j++){     //128 columns wide
        unsigned char byte = pgm_read_byte(&image[a]);
        data_out(byte);    //send picture data
        a++; 
      }
    } 
  } else if (n == 1) { // do bottom
    unsigned int i,j,a;
    a = 0;
    for(i=2;i<4;i++){        
      Set_Start_Page_12832(i);
      Set_Start_Column_12832(0x6f);
      for(j=0;j<14;j++){     //128 columns wide
        unsigned char byte = pgm_read_byte(&image[a]);
        data_out(byte);    //send picture data
        a++; 
      }
    }
  }
}
//-=-=-=-=-=-=-=-=-=-=-=-=-=-=-=-=-=-=-=-=-=-=-=-=-=-=-=-=-=-=-=-=-=-=-=
//  Show Regular Pattern (Partial or Full Screen)
//
//    a: Start Page
//    b: End Page
//    c: Start Column
//    d: Total Columns
//-=-=-=-=-=-=-=-=-=-=-=-=-=-=-=-=-=-=-=-=-=-=-=-=-=-=-=-=-=-=-=-=-=-=-=
void Fill_Block_12832(unsigned char Data, unsigned char a, unsigned char b, unsigned char c, unsigned char d)
{
unsigned char i,j;
	
	for(i=a;i<(b+1);i++)
	{
		Set_Start_Page_12832(i);
		Set_Start_Column_12832(c);

		for(j=0;j<d;j++)
		{
			data_out(Data);
		}
	}
}

//-=-=-=-=-=-=-=-=-=-=-=-=-=-=-=-=-=-=-=-=-=-=-=-=-=-=-=-=-=-=-=-=-=-=-=
//  Bank Color & Look Up Table Setting (Partial Screen)
//-=-=-=-=-=-=-=-=-=-=-=-=-=-=-=-=-=-=-=-=-=-=-=-=-=-=-=-=-=-=-=-=-=-=-=
void Set_LUT_12832(unsigned char a, unsigned char b, unsigned char c, unsigned char d)
{
	comm_out(0x91);			// Define Look Up Table of Area Color
	comm_out(a);			//   Define Bank 0 Pulse Width
	comm_out(b);			//   Define Color A Pulse Width
	comm_out(c);			//   Define Color B Pulse Width
	comm_out(d);			//   Define Color C Pulse Width
}


void Set_Bank_Color_12832()
{
	comm_out(0x92);			// Define Area Color for Bank 1~16 (Page 0)
	comm_out(0x00);			//   Define Bank 1~4 as Color A
	comm_out(0x55);			//   Define Bank 5~8 as Color B
	comm_out(0xAA);			//   Define Bank 9~12 as Color C
	comm_out(0xFF);			//   Define Bank 13~16 as Color D

	comm_out(0x93);			// Define Area Color for Bank 17~32 (Page 1)
	comm_out(0xFF);			//   Define Bank 17~32 as Color D
	comm_out(0xFF);
	comm_out(0xFF);
	comm_out(0xFF);
}


/****************************************************
*           Initialization For controller           *
*****************************************************/

void OLED_Init_12832()
{
  unsigned char i;
  unsigned char Max_Column = 128;
  unsigned char Max_Row = 32;	
  unsigned char Brightness = 0xDC; // orig. 0xBF
  unsigned char XLevelL = 0x04;
  unsigned char XLevelH = 0x10;
	Set_Display_On_Off_12832(0x00);		      // Display Off (0x00/0x01) 
	Set_Display_Clock_12832(0x10);		      // Set Clock as 160 Frames/Sec
	Set_Multiplex_Ratio_12832(0x1F);	      // 1/32 Duty (0x0F~0x3F)
	Set_Display_Offset_12832(0x00);		      // Shift Mapping RAM Counter (0x00~0x3F)
	Set_Start_Line_12832(0x00);		      // Set Mapping RAM Display Start Line (0x00~0x3F)
	Set_Master_Config_12832(0x00);		      // Disable Embedded DC/DC Converter (0x00/0x01)
	Set_Area_Color_12832(0x05);		      // Set Monochrome & Low Power Save Mode
	Set_Addressing_Mode_12832(0x02);	      // Set Page Addressing Mode (0x00/0x01/0x02)
	Set_Segment_Remap_12832(0x01);		      // Set SEG/Column Mapping (0x00/0x01)
	Set_Common_Remap_12832(0x08);		      // Set COM/Row Scan Direction (0x00/0x08)
	Set_Common_Config_12832(0x10);		      // Set Alternative Configuration (0x00/0x10)
	Set_LUT_12832(0x3F,0x3F,0x3F,0x3F);	      // Define All Banks Pulse Width as 64 Clocks
	Set_Contrast_Control_12832(Brightness);	      // Set SEG Output Current
	Set_Area_Brightness_12832(Brightness);	      // Set Brightness for Area Color Banks  
	Set_Precharge_Period_12832(0xD2);	      // Set Pre-Charge as 13 Clocks & Discharge as 2 Clock
	Set_VCOMH_12832(0x08);			      // Set VCOM Deselect Level
	Set_Entire_Display_12832(0x00);		      // Disable Entire Display On (0x00/0x01)
	Set_Inverse_Display_12832(0x00);	      // Disable Inverse Display On (0x00/0x01)

	Fill_RAM_12832(0xff);			      // Clear Screen

	Set_Display_On_Off_12832(0x01);		      // Display On (0x00/0x01)
}



void setup() {
  initIOs();    // Initialize IOs and interrupt
  initADC();    // Initialize ADCs
  initSPImaster();
  testingMode = 0;
  Serial.begin(9600);
  // display
  digitalWrite(RES, LOW);
  delay(150);
  digitalWrite(RES, HIGH);
  delay(150);
  
  OLED_Init_12832(); //Initialization Sequence
  
  Set_Column_Address_12832(0x00,0x83); 
}

void loop() {
  Serial.println(F("\n========================="));
  Serial.println(F("Starting EUR5A Programmer"));
  Serial.println(F("=========================\n"));
  // display
  Fill_RAM_12832(0x00);  
  ImageDisplay(startScreen);
  delay(1500);
  Fill_RAM_12832(0x00);
  ImageDisplay(Phase1);
  while (digitalRead(START_BUTTON) == HIGH) {
    // wait till pressed
  }
  /*
    1. enable program
    2. verify chip id
    3. erase 
    4. program
    5. verify
    6. Fuses
    7. Lock BitsF
  */
  digitalWrite(DUT_PWR, HIGH);
  delay(100); // wait to stabilize
  errCode = doTest();
  digitalWrite(DUT_PWR, LOW);
  delay(500);
  if (errCode) {
    handleError(errCode);
  }
  Fill_RAM_12832(0x00);
  if (!errCode) {
    ImageDisplay(completeScreen);
    delay(650);
    Fill_RAM_12832(0x00);  
    ImageDisplay(restartingScreen);
    delay(650);
  } else {
    ImageDisplay(restartingScreen);
  }
  delay(2000);
}
